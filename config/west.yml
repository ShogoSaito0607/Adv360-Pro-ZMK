## config/west.yml
```yaml
manifest:
  remotes:
    - name: zmkfirmware
      url-base: https://github.com/zmkfirmware
    - name: myRepo
      url-base: https://github.com/ShogoSaito0607
  projects:
    - name: zmk
      remote: myRepo
      revision: adv360-z3
      import: app/west.yml
  self:
    path: config
```
